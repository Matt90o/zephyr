## boards/arm/nrf52832_diamond/Kconfig.board
```kconfig
# Kconfig - nRF52 PCA10040 board configuration
#
# Copyright (c) 2016 Nordic Semiconductor ASA
#
# SPDX-License-Identifier: Apache-2.0

config  BOARD_NRF52832_DIAMOND
	bool "nRF52832 DIAMOND"
	depends on SOC_NRF52832_QFAA
```

## drivers/sensor/mlx90614/Kconfig
```kconfig
# Kconfig - MLX90614 infrared thermopile sensor configuration options

#
# Copyright (c) 2016 Intel Corporation
#
# SPDX-License-Identifier: Apache-2.0
#

menuconfig MLX90614
	bool "MLX90614 Infrared Thermopile Sensor"
	depends on I2C
	help
	  Enable driver for MLX90614 infrared thermopile sensors.

if MLX90614

config MLX90614_NAME
	string "Driver name"
	default "MLX90614"
	help
	  Device name with which the MLX90614 sensor is identified.

config MLX90614_I2C_ADDR
	hex "I2C address for TMP006 Sensor"
	default "0x5A"
	help
	  I2C address of the MLX90614 sensor.

	  0x40: A0 connected GND and A1 connected to GND.
	  0x41: A0 connected VDD and A1 connected to GND.
	  0x42: A0 connected SDA and A1 connected to GND.
	  0x43: A0 connected SCL and A1 connected to GND.
	  0x44: A0 connected GND and A1 connected to VDD.
	  0x45: A0 connected VDD and A1 connected to VDD.
	  0x46: A0 connected SDA and A1 connected to VDD.
	  0x47: A0 connected SCL and A1 connected to VDD.

config MLX90614_I2C_MASTER_DEV_NAME
	string "I2C master where MLX90614 is connected"
	default "I2C_0"
	help
	  Specify the device name of the I2C master device to which the
	  MLX90614 chip is connected.

choice
	prompt "Trigger mode"
	default MLX90614_TRIGGER_NONE
	help
	  Specify the type of triggering to be used by the driver.

config MLX90614_TRIGGER_NONE
	bool "No trigger"

config MLX90614_TRIGGER_GLOBAL_THREAD
	bool "Use global thread"
	depends on GPIO
	select MLX90614_TRIGGER

config MLX90614_TRIGGER_OWN_THREAD
	bool "Use own thread"
	depends on GPIO
	select MLX90614_TRIGGER

endchoice

config MLX90614_TRIGGER
	bool

config MLX90614_GPIO_DEV_NAME
	string "GPIO device"
	default "GPIO_0"
	depends on MLX90614_TRIGGER
	help
	  The device name of the GPIO device to which the MLX90614 interrupt
	  (alert) pin is connected.

config MLX90614_GPIO_PIN_NUM
	int "Interrupt GPIO pin number"
	default 0
	depends on MLX90614_TRIGGER
	help
	  The number of the GPIO pin on which the interrupt signal from the
	  MLX90614 chip will be received.

config MLX90614_THREAD_PRIORITY
	int "Thread priority"
	depends on MLX90614_TRIGGER_OWN_THREAD
	default 10
	help
	  Priority of thread used by the driver to handle interrupts.

config MLX90614_THREAD_STACK_SIZE
	int "Thread stack size"
	depends on MLX90614_TRIGGER_OWN_THREAD
	default 1024
	help
	  Stack size of thread used by the driver to handle interrupts.

endif # MLX90614
```
